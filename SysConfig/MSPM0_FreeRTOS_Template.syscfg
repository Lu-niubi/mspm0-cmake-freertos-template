/**
 * @cliArgs --board "/ti/boards/LP_MSPM0G3507" --product "mspm0_sdk@2.05.01.00"
 * @versions {"tool":"1.24.1+4189"}
 */
scripting.excludeFromBuild("device_linker.lds");

/**
 * Import the modules used in this configuration.
 */
const Board         = scripting.addModule("/ti/driverlib/Board");
const GPIO          = scripting.addModule("/ti/driverlib/GPIO", {}, false);
const GPIO1         = GPIO.addInstance();
const GPIO2         = GPIO.addInstance();
const GPIO3         = GPIO.addInstance();
const GPIO4         = GPIO.addInstance();
const GPIO5         = GPIO.addInstance();
const GPIO6         = GPIO.addInstance();
const GPIO7         = GPIO.addInstance();
const I2C           = scripting.addModule("/ti/driverlib/I2C", {}, false);
const I2C1          = I2C.addInstance();
const MATHACL       = scripting.addModule("/ti/driverlib/MATHACL");
const PWM           = scripting.addModule("/ti/driverlib/PWM", {}, false);
const PWM1          = PWM.addInstance();
const SYSCTL        = scripting.addModule("/ti/driverlib/SYSCTL");
const SYSTICK       = scripting.addModule("/ti/driverlib/SYSTICK");
const UART          = scripting.addModule("/ti/driverlib/UART", {}, false);
const UART1         = UART.addInstance();
const ProjectConfig = scripting.addModule("/ti/project_config/ProjectConfig");

/**
 * Write custom configuration values to the imported modules.
 */
const divider9       = system.clockTree["UDIV"];
divider9.divideValue = 2;

const gate7  = system.clockTree["MFCLKGATE"];
gate7.enable = true;

const gate8  = system.clockTree["MFPCLKGATE"];
gate8.enable = true;

const multiplier2         = system.clockTree["PLL_QDIV"];
multiplier2.multiplyValue = 4;

const mux4       = system.clockTree["EXHFMUX"];
mux4.inputSelect = "EXHFMUX_XTAL";

const mux8       = system.clockTree["HSCLKMUX"];
mux8.inputSelect = "HSCLKMUX_SYSPLL0";

const mux12       = system.clockTree["SYSPLLMUX"];
mux12.inputSelect = "zSYSPLLMUX_HFCLK";

const pinFunction4                        = system.clockTree["HFXT"];
pinFunction4.enable                       = true;
pinFunction4.inputFreq                    = 40;
pinFunction4.peripheral.$assign           = "SYSCTL";
pinFunction4.peripheral.hfxInPin.$assign  = "j17_expansion.4";
pinFunction4.peripheral.hfxOutPin.$assign = "j17_expansion.5";

Board.peripheral.$assign          = "DEBUGSS";
Board.peripheral.swclkPin.$assign = "j25_expansion.16";
Board.peripheral.swdioPin.$assign = "j25_expansion.14";

GPIO1.$name                                 = "PORTA";
GPIO1.port                                  = "PORTA";
GPIO1.associatedPins[0].$name               = "LED_USER";
GPIO1.associatedPins[0].assignedPortSegment = "Lower";
GPIO1.associatedPins[0].initialValue        = "SET";
GPIO1.associatedPins[0].assignedPin         = "4";
GPIO1.associatedPins[0].pin.$assign         = "j17_expansion.3";

GPIO2.$name                         = "GPIO_LED";
GPIO2.port                          = "PORTB";
GPIO2.associatedPins[0].$name       = "PIN_LED";
GPIO2.associatedPins[0].assignedPin = "22";

GPIO3.$name                         = "Tracking";
GPIO3.associatedPins.create(8);
GPIO3.associatedPins[0].$name       = "L1";
GPIO3.associatedPins[0].direction   = "INPUT";
GPIO3.associatedPins[0].pin.$assign = "boosterpack.27";
GPIO3.associatedPins[1].direction   = "INPUT";
GPIO3.associatedPins[1].$name       = "L2";
GPIO3.associatedPins[1].pin.$assign = "boosterpack.6";
GPIO3.associatedPins[2].$name       = "L3";
GPIO3.associatedPins[2].direction   = "INPUT";
GPIO3.associatedPins[2].pin.$assign = "j19_expansion.7";
GPIO3.associatedPins[3].$name       = "L4";
GPIO3.associatedPins[3].direction   = "INPUT";
GPIO3.associatedPins[3].pin.$assign = "boosterpack.36";
GPIO3.associatedPins[4].$name       = "R4";
GPIO3.associatedPins[4].direction   = "INPUT";
GPIO3.associatedPins[4].pin.$assign = "j17_expansion.7";
GPIO3.associatedPins[5].direction   = "INPUT";
GPIO3.associatedPins[5].$name       = "R3";
GPIO3.associatedPins[5].pin.$assign = "boosterpack.25";
GPIO3.associatedPins[6].$name       = "R2";
GPIO3.associatedPins[6].direction   = "INPUT";
GPIO3.associatedPins[6].pin.$assign = "boosterpack.23";
GPIO3.associatedPins[7].$name       = "R1";
GPIO3.associatedPins[7].direction   = "INPUT";
GPIO3.associatedPins[7].pin.$assign = "j21_expansion.3";

GPIO4.$name                               = "GPIO_Encoder";
GPIO4.associatedPins.create(4);
GPIO4.associatedPins[0].$name             = "PIN_Front_Left_A";
GPIO4.associatedPins[0].direction         = "INPUT";
GPIO4.associatedPins[0].interruptEn       = true;
GPIO4.associatedPins[0].interruptPriority = "0";
GPIO4.associatedPins[0].polarity          = "RISE";
GPIO4.associatedPins[0].pin.$assign       = "boosterpack.30";
GPIO4.associatedPins[1].$name             = "PIN_Front_Left_B";
GPIO4.associatedPins[1].direction         = "INPUT";
GPIO4.associatedPins[1].pin.$assign       = "boosterpack.29";
GPIO4.associatedPins[2].$name             = "PIN_Front_Right_A";
GPIO4.associatedPins[2].direction         = "INPUT";
GPIO4.associatedPins[2].interruptEn       = true;
GPIO4.associatedPins[2].interruptPriority = "0";
GPIO4.associatedPins[2].polarity          = "RISE";
GPIO4.associatedPins[2].pin.$assign       = "boosterpack.24";
GPIO4.associatedPins[3].$name             = "PIN_Front_Right_B";
GPIO4.associatedPins[3].direction         = "INPUT";
GPIO4.associatedPins[3].pin.$assign       = "boosterpack.28";

GPIO5.$name                         = "GPIO_IN";
GPIO5.associatedPins.create(4);
GPIO5.associatedPins[0].$name       = "GPIO_AIN1";
GPIO5.associatedPins[0].pin.$assign = "boosterpack.31";
GPIO5.associatedPins[1].$name       = "GPIO_AIN2";
GPIO5.associatedPins[1].pin.$assign = "boosterpack.32";
GPIO5.associatedPins[2].$name       = "GPIO_BIN1";
GPIO5.associatedPins[2].pin.$assign = "boosterpack.12";
GPIO5.associatedPins[3].$name       = "GPIO_BIN2";
GPIO5.associatedPins[3].pin.$assign = "boosterpack.11";

GPIO6.$name                              = "GPIO_KEY";
GPIO6.associatedPins.create(3);
GPIO6.associatedPins[0].$name            = "KEY_A26";
GPIO6.associatedPins[0].direction        = "INPUT";
GPIO6.associatedPins[0].internalResistor = "PULL_UP";
GPIO6.associatedPins[0].pin.$assign      = "boosterpack.5";
GPIO6.associatedPins[1].$name            = "KEY_A25";
GPIO6.associatedPins[1].internalResistor = "PULL_UP";
GPIO6.associatedPins[1].direction        = "INPUT";
GPIO6.associatedPins[1].pin.$assign      = "boosterpack.2";
GPIO6.associatedPins[2].$name            = "KEY_B26";
GPIO6.associatedPins[2].direction        = "INPUT";
GPIO6.associatedPins[2].internalResistor = "PULL_UP";
GPIO6.associatedPins[2].pin.$assign      = "j19_expansion.8";

GPIO7.$name                         = "GPIO_OLED";
GPIO7.associatedPins.create(2);
GPIO7.associatedPins[0].$name       = "PIN_OLED_SCL";
GPIO7.associatedPins[0].pin.$assign = "boosterpack.37";
GPIO7.associatedPins[1].$name       = "PIN_OLED_SDA";
GPIO7.associatedPins[1].pin.$assign = "boosterpack.38";

I2C1.$name                             = "I2C_MPU6050";
I2C1.basicEnableController             = true;
I2C1.basicControllerStandardBusSpeed   = "Fast";
I2C1.peripheral.sdaPin.$assign         = "boosterpack.34";
I2C1.peripheral.sclPin.$assign         = "boosterpack.33";
I2C1.sdaPinConfig.hideOutputInversion  = scripting.forceWrite(false);
I2C1.sdaPinConfig.onlyInternalResistor = scripting.forceWrite(false);
I2C1.sdaPinConfig.passedPeripheralType = scripting.forceWrite("Digital");
I2C1.sdaPinConfig.$name                = "ti_driverlib_gpio_GPIOPinGeneric2";
I2C1.sclPinConfig.hideOutputInversion  = scripting.forceWrite(false);
I2C1.sclPinConfig.onlyInternalResistor = scripting.forceWrite(false);
I2C1.sclPinConfig.passedPeripheralType = scripting.forceWrite("Digital");
I2C1.sclPinConfig.$name                = "ti_driverlib_gpio_GPIOPinGeneric3";

PWM1.$name                      = "PWM_0";
PWM1.clockPrescale              = 8;
PWM1.pwmMode                    = "EDGE_ALIGN_UP";
PWM1.peripheral.ccp0Pin.$assign = "boosterpack.40";
PWM1.peripheral.ccp1Pin.$assign = "boosterpack.39";
PWM1.PWM_CHANNEL_0.$name        = "ti_driverlib_pwm_PWMTimerCC0";
PWM1.PWM_CHANNEL_1.$name        = "ti_driverlib_pwm_PWMTimerCC1";
PWM1.ccp0PinConfig.$name        = "ti_driverlib_gpio_GPIOPinGeneric4";
PWM1.ccp1PinConfig.$name        = "ti_driverlib_gpio_GPIOPinGeneric5";

SYSCTL.clockTreeEn           = true;
SYSCTL.validateClkStatus     = true;
SYSCTL.forceDefaultClkConfig = true;
scripting.suppress("For best practices when the CPUCLK is running at 32MHz and above, clear the flash status bit using DL_FlashCTL_executeClearStatus\\(\\) before executing any flash operation\\. Otherwise there may be false positives\\.", SYSCTL);

SYSTICK.periodEnable      = true;
SYSTICK.interruptEnable   = true;
SYSTICK.systickEnable     = true;
SYSTICK.period            = 80000;
SYSTICK.interruptPriority = "0";

UART1.enableDMARX                      = false;
UART1.enableDMATX                      = false;
UART1.$name                            = "UART0";
UART1.enableFIFO                       = true;
UART1.targetBaudRate                   = 115200;
UART1.peripheral.$assign               = "UART0";
UART1.peripheral.rxPin.$assign         = "j17_expansion.9";
UART1.peripheral.txPin.$assign         = "j19_expansion.9";
UART1.txPinConfig.direction            = scripting.forceWrite("OUTPUT");
UART1.txPinConfig.hideOutputInversion  = scripting.forceWrite(false);
UART1.txPinConfig.onlyInternalResistor = scripting.forceWrite(false);
UART1.txPinConfig.passedPeripheralType = scripting.forceWrite("Digital");
UART1.txPinConfig.$name                = "ti_driverlib_gpio_GPIOPinGeneric0";
UART1.rxPinConfig.hideOutputInversion  = scripting.forceWrite(false);
UART1.rxPinConfig.onlyInternalResistor = scripting.forceWrite(false);
UART1.rxPinConfig.passedPeripheralType = scripting.forceWrite("Digital");
UART1.rxPinConfig.$name                = "ti_driverlib_gpio_GPIOPinGeneric1";

ProjectConfig.genLibIQVersion    = "MATHACL";
ProjectConfig.migrationCondition = true;

/**
 * Pinmux solution for unlocked pins/peripherals. This ensures that minor changes to the automatic solver in a future
 * version of the tool will not impact the pinmux you originally saw.  These lines can be completely deleted in order to
 * re-solve from scratch.
 */
GPIO2.associatedPins[0].pin.$suggestSolution = "j19_expansion.5";
I2C1.peripheral.$suggestSolution             = "I2C0";
PWM1.peripheral.$suggestSolution             = "TIMA1";
